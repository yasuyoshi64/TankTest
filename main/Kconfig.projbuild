## main/Kconfig.projbuild
```kconfig
menu "MotorControlExample"
    config LED_PIN
        int "LED GPIO number"
        default 5

    config BTN_PIN
        int "BTN GPIO number"
        default 2

    menu "SD card PIN configuration"
        config CS_PIN
            int "CS(DAT3/CD) GPIO number"
            default 16
    
        config MOSI_PIN
            int "MOSI(CMD) GPIO number"
            default 17
        
        config CLK_PIN
            int "CLK GPIO number"
            default 18

        config MISO_PIN
            int "MOSO(DAT0) GPIO number"
            default 19

        config CARD_SW_PIN
            int "SD card sw GPIO number"
            default 4
    endmenu

    menu "OLED(SSD1306) PIN configuration"
        config SDA_PIN
            int "I2C SDA GPIO number"
            default 21

        config SCL_PIN
            int "I2C SCL GPIO number"
            default 22
    endmenu

    menu "Motor(DRV8835) PIN configuration"
        config AIN1_PIN
            int "AIN1 GPIO number"
            default 12

        config AIN2_PIN
            int "AIN2 GPIO number"
            default 13

        config BIN1_PIN
            int "BIN1 GPIO number"
            default 14

        config BIN2_PIN
            int "BIN2 GPIO number"
            default 15
    endmenu

    menu "Servo A PIN configuration"
        config A_PWM_PIN
            int "PWM GPIO NUMBER"
            default 32
    endmenu

    menu "Servo B PIN configuration"
        config B_PWM_PIN
            int "PWM GPIO NUMBER"
            default 33
    endmenu

endmenu
```
